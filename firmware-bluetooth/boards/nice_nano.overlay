/ {
	chosen {
		/delete-property/ zephyr,console;
		/delete-property/ zephyr,shell-uart;
		};
	};

	buttons {
		compatible = "gpio-keys";
		button0: button_0 {
			gpios = <&pro_micro 2 (GPIO_PULL_UP | GPIO_ACTIVE_LOW)>;
			label = "Pair button (D2)";
		};
	};

	leds {
		/* There's only one LED on the board, so for activity we
		 * use the next pin on the header, where the user can wire
		 * an LED if they want. */
		activity_led: led_1 {
			gpios = <&pro_micro 3 GPIO_ACTIVE_HIGH>;
			label = "Activity LED (D3)";
		};
	};

	aliases {
		led0 = &activity_led;
		led1 = &blue_led;
		sw0 = &button0;
	};
};

&pinctrl {
	uart0_default: uart0_default {
		group1 {
			psels = <NRF_PSEL(UART_TX, 0, 6)>,
				<NRF_PSEL(UART_RX, 0, 8)>;
		};
	};

	uart0_sleep: uart0_sleep {
		group1 {
			psels = <NRF_PSEL(UART_TX, 0, 6)>,
				<NRF_PSEL(UART_RX, 0, 8)>;
			low-power-enable;
		};
	};
};

&uart0 {
	compatible = "nordic,nrf-uarte";
	status = "okay";
	current-speed = <921600>;
	pinctrl-0 = <&uart0_default>;
	pinctrl-1 = <&uart0_sleep>;
	pinctrl-names = "default", "sleep";
};